#pragma once
// GERADO por tools/gen_dashboard.py - nao edite manualmente.
// Fonte: src/web/dashboard.html + tools/fonts/*.woff2
#include <Arduino.h>
static const uint8_t FONT_CHAKRA_WOFF2[] PROGMEM = {119,79,70,50,0,1,0,0,0,0,38,240,0,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94,2};
static const size_t FONT_CHAKRA_WOFF2_LEN = 9968;
static const uint8_t FONT_PLEX_WOFF2[] PROGMEM = {119,79,70,50,0,1,0,0,0,0,178,144,0,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176,91};
static const size_t FONT_PLEX_WOFF2_LEN = 45712;
static const char DASHBOARD_HTML[] PROGMEM = R"rawliteral(<!DOCTYPE html>
<html lang="pt-BR">
<head>
<meta charset="utf-8">
<meta name="viewport" content="width=device-width, initial-scale=1">
<meta name="color-scheme" content="light">
<title>SAEG · Controle Térmico</title>
<style>
/* ===== Fontes servidas pelo proprio ESP8266 (offline: AP sem internet) =====
   Servidas como rota separada + cache longo (Cache-Control) em vez de embutir
   base64 no HTML: mantem a resposta de "/" pequena e o carregamento fluido
   (NFR-TIM-005/CA-UI-007). Fallback de sistema aplica-se enquanto carregam. */
@font-face{font-family:'Chakra Petch';font-style:normal;font-weight:600;font-display:swap;src:url(/fonts/chakra-petch-600-latin.woff2) format('woff2');}
@font-face{font-family:'IBM Plex Sans';font-style:normal;font-weight:400 500;font-display:swap;src:url(/fonts/ibm-plex-sans-400-500-latin.woff2) format('woff2');}

/* ===== Paleta: painel de instrumentacao industrial ===== */
:root{
  --bg:#F4F3EE; --panel:#FFFFFF; --ink:#1F2933; --ink-soft:#5B6673;
  --grid:#D8DAD2; --line:#E3E2DB; --accent:#E8730A; --ok:#1A7F37; --off:#C5221F;
  --risk:rgba(197,34,31,.10); --risk-line:rgba(197,34,31,.32);
  --shadow:0 1px 2px rgba(31,41,51,.06), 0 6px 18px rgba(31,41,51,.05);
  --disp:'Chakra Petch','IBM Plex Sans',ui-monospace,'Cascadia Mono','Segoe UI Mono',Consolas,monospace;
  --body:'IBM Plex Sans',system-ui,-apple-system,'Segoe UI',Roboto,sans-serif;
}
*{box-sizing:border-box;margin:0;padding:0}
html,body{height:100%}
body{
  font-family:var(--body); color:var(--ink); background:
    radial-gradient(1200px 500px at 85% -10%, rgba(232,115,10,.06), transparent 60%),
    var(--bg);
  display:flex; flex-direction:column; min-height:100vh; height:100vh; overflow:hidden;
}
.hidden{display:none!important}

/* ===== Cabeçalho ===== */
header{
  display:flex; align-items:center; gap:18px; flex-wrap:wrap;
  padding:14px 22px; background:var(--panel); border-bottom:1px solid var(--line);
  box-shadow:var(--shadow); z-index:5;
}
.brand{display:flex; flex-direction:column; line-height:1.05; margin-right:auto}
.brand b{font-family:var(--disp); font-weight:600; font-size:20px; letter-spacing:.04em; text-transform:uppercase}
.brand small{color:var(--ink-soft); font-size:11px; letter-spacing:.22em; text-transform:uppercase}
.badge{
  font-family:var(--disp); font-size:12px; font-weight:600; letter-spacing:.12em;
  padding:6px 12px; border-radius:3px; border:1px solid transparent; text-transform:uppercase;
}
.badge.ok{color:var(--ok); background:rgba(26,127,55,.08); border-color:rgba(26,127,55,.35)}
.badge.alarm{color:#fff; background:var(--off); animation:pulse 1.4s ease-in-out infinite}
.badge.fail{color:#7a2e12; background:rgba(232,115,10,.16); border-color:rgba(232,115,10,.5)}
.badge.safe{color:#7a5a10; background:rgba(180,140,20,.14); border-color:rgba(180,140,20,.45)}
@keyframes pulse{0%,100%{opacity:1}50%{opacity:.55}}
.metrics{display:flex; gap:8px; flex-wrap:wrap}
.metric{
  font-size:11px; color:var(--ink-soft); background:var(--bg); border:1px solid var(--line);
  padding:6px 10px; border-radius:3px; display:flex; flex-direction:column; gap:1px;
}
.metric span{font-family:var(--disp); font-size:14px; color:var(--ink)}

/* ===== Layout principal ===== */
main{
  flex:1; min-height:0; display:grid; grid-template-columns:minmax(320px,5fr) minmax(380px,7fr);
  gap:16px; padding:16px 22px;
}
.panel{background:var(--panel); border:1px solid var(--line); border-radius:6px; box-shadow:var(--shadow);
  display:flex; flex-direction:column; padding:14px 16px; min-height:0; overflow:hidden}
.panel h2{font-family:var(--disp); font-size:11px; font-weight:600; letter-spacing:.2em;
  text-transform:uppercase; color:var(--ink-soft); margin-bottom:6px; display:flex; align-items:center; gap:8px}
.panel h2::after{content:""; flex:1; height:1px; background:var(--line)}

/* Gauge */
#gauge-panel{justify-content:center; align-items:center; text-align:center}
.readout{font-family:var(--disp); font-size:64px; font-weight:600; line-height:1; color:var(--ink);
  font-variant-numeric:tabular-nums; transition:color .2s}
.readout small{font-size:22px; color:var(--ink-soft); font-weight:400; margin-left:4px}
.readout.hot{color:var(--off)}
.readout.fail{color:var(--accent)}
canvas#gauge{width:100%; max-width:360px; height:auto; aspect-ratio:22/13; display:block}
.load-ind{display:inline-flex; align-items:center; gap:8px; margin-top:6px; font-size:12px; color:var(--ink-soft)}
.dot{width:11px; height:11px; border-radius:50%; background:var(--off); box-shadow:0 0 0 3px rgba(197,34,31,.12)}
.dot.on{background:var(--ok); box-shadow:0 0 0 3px rgba(26,127,55,.15)}

/* Gráfico */
#chart-panel{flex:1}
canvas#trend{flex:1; width:100%; min-height:0; display:block}
.chart-legend{font-size:11px; color:var(--ink-soft); display:flex; gap:14px; align-items:center;
  padding-top:8px; border-top:1px solid var(--line)}
.chart-legend i{width:18px; height:3px; display:inline-block; border-radius:2px; vertical-align:middle; margin-right:4px}
.swatch-accent{background:var(--accent)} .swatch-risk{background:var(--risk-line)}

/* ===== Controle da carga ===== */
footer{
  display:flex; align-items:center; gap:16px; flex-wrap:wrap;
  padding:12px 22px 16px; background:var(--panel); border-top:1px solid var(--line);
}
.btn-load{
  font-family:var(--disp); font-weight:600; font-size:15px; letter-spacing:.14em; text-transform:uppercase;
  border:2px solid var(--off); background:var(--off); color:#fff;
  padding:12px 34px; border-radius:4px; cursor:pointer; min-width:170px;
  transition:transform .08s ease, box-shadow .15s ease, background .2s;
}
.btn-load:not(:disabled):active{transform:translateY(1px)}
.btn-load.on{background:var(--ok); border-color:var(--ok)}
.btn-load:disabled{background:var(--grid); border-color:var(--grid); color:#8a9099; cursor:not-allowed; box-shadow:none}
.btn-load:not(:disabled):hover{box-shadow:0 4px 14px rgba(31,41,51,.18)}
.ctrl-msg{font-size:12px; color:var(--ink-soft); max-width:420px}

/* ===== Tooltips ===== */
.tip{position:relative; cursor:help}
.tip::after{
  content:attr(data-tip);
  position:absolute; bottom:130%; left:50%; transform:translateX(-50%) translateY(4px);
  background:var(--ink); color:var(--bg); padding:6px 10px; border-radius:4px;
  font-size:11px; font-family:var(--body); font-weight:400; letter-spacing:0;
  white-space:nowrap; opacity:0; pointer-events:none; transition:opacity .15s ease, transform .15s ease;
  z-index:20; box-shadow:0 4px 12px rgba(0,0,0,.2);
}
.tip-top::after{bottom:auto; top:130%; transform:translateX(-50%) translateY(-4px)}
.tip:hover::after, .tip:focus-visible::after{opacity:1; transform:translateX(-50%) translateY(0)}

/* ===== Responsivo ===== */
@media (max-width:899px){
  body{height:auto; min-height:100vh; overflow:auto}
  main{grid-template-columns:1fr; grid-auto-rows:auto}
  .readout{font-size:48px}
  .brand{flex-basis:100%}
}
@media (prefers-reduced-motion: reduce){
  *,*::before,*::after{transition:none!important; animation:none!important}
}
</style>
</head>
<body>

<header>
  <div class="brand">
    <b>SAEG · Controle Térmico</b>
    <small>ESP8266 · 192.168.4.1</small>
  </div>
  <div class="metrics">
    <div class="metric tip" tabindex="0" data-tip="Tempo ocioso do loop na última janela de 1 s (quanto maior, mais folga de CPU).">
      Carga idle <span id="m-idle">--</span>
    </div>
    <div class="metric tip" tabindex="0" data-tip="Memória RAM livre (heap). Abaixo de 10 KB indica risco de instabilidade.">
      RAM livre <span id="m-ram">--</span>
    </div>
    <div class="metric tip" tabindex="0" data-tip="Ocupação da flash pelo firmware (sketch). Limite da plataforma: 4 MB.">
      Flash <span id="m-flash">--</span>
    </div>
  </div>
  <div id="status" class="badge safe" role="status">SENSOR AUSENTE</div>
</header>

<main>
  <section id="gauge-panel" class="panel">
    <h2>Temperatura</h2>
    <div id="readout" class="readout tip" tabindex="0" data-tip="Temperatura atual do DS18B20. Escala do instrumento: 20 °C a 90 °C; zona vermelha = risco (≥ 70 °C).">--<small>°C</small></div>
    <canvas id="gauge" class="tip" tabindex="0" data-tip="Mostrador semicircular: agulha indica a temperatura atual; a faixa vermelha é a zona de risco térmico."></canvas>
    <div class="load-ind"><span id="load-dot" class="dot"></span><span id="load-txt">Carga desligada</span></div>
  </section>

  <section id="chart-panel" class="panel">
    <h2>Tendência · últimos 3 min</h2>
    <canvas id="trend" class="tip" tabindex="0" data-tip="Gráfico com escala fixa de 20 °C a 90 °C (não auto-ajustável) para perceber a proximidade do limite de 80 °C. Janela de 120 pontos (amostragem a cada 1,5 s ≈ 3 min). Área sombreada = zona de risco."></canvas>
    <div class="chart-legend">
      <span><i class="swatch-accent"></i>Temperatura</span>
      <span><i class="swatch-risk"></i>Zona de risco ≥ 70 °C</span>
      <span style="margin-left:auto">Limite de segurança: 80 °C</span>
    </div>
  </section>
</main>

<footer>
  <button id="btn-load" class="btn-load" type="button" data-tip="Liga/desliga a resistência de aquecimento (PWM 1023 / 0).">DESLIGADO</button>
  <div class="ctrl-msg tip" id="ctrl-msg" tabindex="0" data-tip="Estado da carga e motivo de bloqueio (intertravamento de segurança).">Carga desligada. Toque em LIGAR para acionar a resistência.</div>
</footer>

<script>
"use strict";
/* ===== Constantes ===== */
const TMIN=20, TMAX=90, TRISK=70, TALERT=80, TRENDN=120;
const $=id=>document.getElementById(id);
const gauge=$('gauge'), trend=$('trend');
const gctx=gauge.getContext('2d'), tctx=trend.getContext('2d');
const clamp=(v,a,b)=>Math.min(b,Math.max(a,v));
const fmt=(v,d=1)=>v==null?'--':Number(v).toFixed(d);
let trendData=[], lastTemp=null, curLoad=false, fetching=false, state=null;

/* ===== Gauge (canvas) ===== */
function drawGauge(t){
  const c=gauge, w=c.width, h=c.height;
  gctx.clearRect(0,0,w,h);
  const cx=w/2, cy=h*0.82, r=Math.min(w*0.42, h*0.82);
  // Angulo cresce de PI (esquerda) a 2*PI (direita), passando por 3*PI/2
  // (topo) no meio da faixa -> semicirculo SUPERIOR (bug anterior desenhava
  // o arco para baixo do pivo, cortado pelo painel).
  const ang=v=>Math.PI*(1+(clamp(v,TMIN,TMAX)-TMIN)/(TMAX-TMIN));
  const arc=(from,to,color,lw)=>{
    gctx.strokeStyle=color; gctx.lineWidth=lw; gctx.lineCap='round';
    gctx.beginPath(); gctx.arc(cx,cy,r,ang(from),ang(to)); gctx.stroke();
  };
  arc(TMIN,TMAX,'#E3E2DB',Math.max(3,r*0.07));          // trilho
  arc(TRISK,TMAX,'rgba(197,34,31,.30)',Math.max(3,r*0.07)); // zona de risco
  gctx.lineWidth=2; gctx.strokeStyle='#5B6673';         // ticks
  for(let v=TMIN; v<=TMAX; v+=10){
    const a=ang(v);
    gctx.beginPath();
    gctx.moveTo(cx+Math.cos(a)*(r-r*0.20), cy+Math.sin(a)*(r-r*0.20));
    gctx.lineTo(cx+Math.cos(a)*(r-r*0.10), cy+Math.sin(a)*(r-r*0.10));
    gctx.stroke();
  }
  const a=ang(t==null?TMIN:t);                          // agulha
  gctx.strokeStyle='#1F2933'; gctx.lineWidth=Math.max(3,r*0.055);
  gctx.beginPath(); gctx.moveTo(cx,cy); gctx.lineTo(cx+Math.cos(a)*r*0.84, cy+Math.sin(a)*r*0.84); gctx.stroke();
  gctx.fillStyle='#1F2933';                             // pivo
  gctx.beginPath(); gctx.arc(cx,cy,r*0.07,0,Math.PI*2); gctx.fill();
}

/* ===== Gráfico de tendência (canvas) ===== */
function drawTrend(){
  const c=trend, w=c.width, h=c.height;
  tctx.clearRect(0,0,w,h);
  const padL=30, padR=10, padT=12, padB=22, gw=w-padL-padR, gh=h-padT-padB;
  const X=i=>padL+gw*i/(TRENDN-1);
  const Y=v=>padT+gh*(1-(clamp(v,TMIN,TMAX)-TMIN)/(TMAX-TMIN));
  tctx.font='10px "IBM Plex Sans", sans-serif'; tctx.fillStyle='#5B6673';
  tctx.strokeStyle='#D8DAD2'; tctx.lineWidth=1;        // grade cinza clara (fixa)
  for(let v=TMIN; v<=TMAX; v+=10){
    const yv=Y(v);
    tctx.beginPath(); tctx.moveTo(padL,yv); tctx.lineTo(w-padR,yv); tctx.stroke();
    tctx.fillText(v+'°',4,yv+3);
  }
  tctx.fillStyle='rgba(197,34,31,.09)';                // zona de risco ≥70
  tctx.fillRect(padL,Y(TRISK),gw,padT+gh-Y(TRISK));
  tctx.strokeStyle='rgba(197,34,31,.35)'; tctx.beginPath();
  tctx.moveTo(padL,Y(TRISK)); tctx.lineTo(w-padR,Y(TRISK)); tctx.stroke();
  if(trendData.length>1){                              // linha da temperatura
    const off=TRENDN-trendData.length;
    tctx.strokeStyle='#E8730A'; tctx.lineWidth=2; tctx.lineJoin='round';
    tctx.beginPath();
    for(let i=0;i<trendData.length;i++){
      const px=X(i+off), py=Y(trendData[i]);
      i?tctx.lineTo(px,py):tctx.moveTo(px,py);
    }
    tctx.stroke();
    const px=X(TRENDN-1), py=Y(trendData[trendData.length-1]);
    tctx.fillStyle='#E8730A'; tctx.beginPath(); tctx.arc(px,py,3,0,Math.PI*2); tctx.fill();
  }
}

/* ===== Redimensionamento ===== */
function resize(){
  const dpr=window.devicePixelRatio||1;
  for(const c of [gauge,trend]){
    const rect=c.getBoundingClientRect();
    c.width=Math.max(10,Math.round(rect.width*dpr));
    c.height=Math.max(10,Math.round(rect.height*dpr));
  }
  drawGauge(lastTemp); drawTrend();
}
window.addEventListener('resize',resize);

/* ===== Estado visual ===== */
function setStatus(d){
  const s=$('status');
  if(d.alarm==='TEMP_HIGH'){s.textContent='ALARME TÉRMICO'; s.className='badge alarm';}
  else if(d.alarm==='SENSOR_FAIL'){s.textContent='FALHA DE SENSOR'; s.className='badge fail';}
  else if(!d.sensorPresent){s.textContent='SENSOR AUSENTE'; s.className='badge safe';}
  else{s.textContent='SENSOR OPERANDO'; s.className='badge ok';}
}

function setButton(d){
  curLoad=!!d.load;
  const interlock=(d.alarm!=='NONE')||!d.sensorPresent;
  const btn=$('btn-load'), dot=$('load-dot'), txt=$('load-txt'), msg=$('ctrl-msg');
  btn.textContent=curLoad?'LIGADO':'DESLIGADO';
  btn.classList.toggle('on',curLoad);
  btn.disabled=interlock;
  dot.classList.toggle('on',curLoad);
  txt.textContent=curLoad?'Carga ligada':'Carga desligada';
  if(interlock){
    msg.dataset.tip='Intertravamento de segurança ativo: a carga não pode ser acionada.';
    msg.textContent=d.alarm==='TEMP_HIGH'
      ?'Carga bloqueada: temperatura ≥ 80 °C.'
      :d.alarm==='SENSOR_FAIL'
        ?'Carga bloqueada: falha de comunicação com o sensor.'
        :'Carga bloqueada: sensor não detectado.';
  }else{
    msg.dataset.tip='Estado da carga e motivo de bloqueio (intertravamento de segurança).';
    msg.textContent=curLoad?'Resistência ligada (PWM 1023). Toque para desligar.'
      :'Carga desligada. Toque em LIGADO para acionar a resistência.';
  }
}

function render(d){
  state=d; // estado mais recente p/ feedback imediato do controle
  lastTemp=d.tempValid?Number(d.temp):null;
  const ro=$('readout');
  ro.innerHTML=(lastTemp==null?'--':fmt(lastTemp))+'<small>°C</small>';
  ro.classList.toggle('hot',d.alarm==='TEMP_HIGH');
  ro.classList.toggle('fail',d.alarm==='SENSOR_FAIL');
  if(Array.isArray(d.trend)) trendData=d.trend;
  drawGauge(lastTemp); drawTrend();
  $('m-idle').textContent=fmt(d.idle,1)+'%';
  $('m-ram').textContent=d.heapFree+' KB';
  $('m-flash').textContent=fmt(d.flashUsedPct,1)+'%';
  setStatus(d); setButton(d);
}

/* ===== Polling AJAX (FR-UI-007 / NFR-UI-001: 1s, in-flight único) ===== */
async function poll(){
  if(fetching) return;
  fetching=true;
  try{
    const r=await fetch('/json');
    if(r.ok) render(await r.json());
  }catch(e){/* mantém último estado */}
  fetching=false;
  setTimeout(poll,1000);
}

/* ===== Controle ON/OFF (POST /control) ===== */
async function toggleLoad(){
  const btn=$('btn-load');
  if(btn.disabled) return;
  const target=!curLoad;
  try{
    const r=await fetch('/control?on='+(target?1:0),{method:'POST'});
    const d=await r.json();
    if(d.accepted && state){
      state.load=!!d.on;      // resposta do controle não traz alarm/sensorPresent
      setButton(state);       // atualiza botão/estado imediatamente
      $('ctrl-msg').textContent = d.on ? 'Resistência ligada (PWM 1023).' : 'Carga desligada.';
    }else{
      $('ctrl-msg').textContent='Comando rejeitado pelo intertravamento de segurança.';
    }
    poll(); // força leitura imediata
  }catch(e){}
}
$('btn-load').addEventListener('click',toggleLoad);

/* ===== Início ===== */
resize();
poll();
</script>
</body>
</html>
)rawliteral";
